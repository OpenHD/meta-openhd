## conf/layer.conf
```bitbake
# We have a conf and classes directory, add to BBPATH
BBPATH .= ":${LAYERDIR}"

# We have recipes-* directories, add to BBFILES
BBFILES += "${LAYERDIR}/recipes-*/*/*.bb \
            ${LAYERDIR}/recipes-*/*/*.bbappend"

# Device-dependent locations
BBFILES_DYNAMIC += " \
    freescale-layer:${LAYERDIR}/dynamic-layers/meta-freescale/recipes-*/*/*.bb \
    freescale-layer:${LAYERDIR}/dynamic-layers/meta-freescale/recipes-*/*/*.bbappend \
    freescale-distro:${LAYERDIR}/dynamic-layers/meta-freescale-distro/recipes-*/*/*.bb \
    freescale-distro:${LAYERDIR}/dynamic-layers/meta-freescale-distro/recipes-*/*/*.bbappend \
    imx-frdm-sdk-release:${LAYERDIR}/dynamic-layers/meta-imx-sdk/recipes-*/*/*.bb \
    imx-frdm-sdk-release:${LAYERDIR}/dynamic-layers/meta-imx-sdk/recipes-*/*/*.bbappend \
"

BBFILE_COLLECTIONS += "meta-openhd"
BBFILE_PATTERN_meta-openhd = "^${LAYERDIR}/"
BBFILE_PRIORITY_meta-openhd = "6"

LAYERDEPENDS_meta-openhd = "core"
LAYERSERIES_COMPAT_meta-openhd = "kirkstone scarthgap"
```

## recipes-kernel/linux/files/hantro_v4l2/Kconfig
```kconfig
# SPDX-License-Identifier: GPL-2.0-only
# Hantro V4L2 driver (OpenHD custom)

config MXC_HANTRO_V4L2
	tristate "Hantro V4L2 encoder/decoder support"
	depends on VIDEO_DEV
	help
	  Enable the OpenHD Hantro V4L2 encoder/decoder driver for i.MX.
```
